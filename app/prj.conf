## CMakeLists.txt
```
#-------------------------------------------------------------------------------
# Zephyr Example Application
#
# Copyright (c) 2021 Nordic Semiconductor ASA
# SPDX-License-Identifier: Apache-2.0

cmake_minimum_required(VERSION 3.13.1)
find_package(Zephyr REQUIRED HINTS $ENV{ZEPHYR_BASE})

project(app LANGUAGES C)

target_sources(app PRIVATE 
    src/main.c
    src/dhcp_req.c
    src/fsm.c
    src/fsm_thread.c
    src/udp_transport.c
    src/ports/ports.c
    src/state_handlers/booting_handler.c
    src/state_handlers/stopped_handler.c
    src/state_handlers/idle_handler.c
    src/state_handlers/execute_handler.c
    src/state_handlers/holding_handler.c
    src/state_handlers/held_handler.c
    src/state_handlers/stopping_handler.c
    src/state_handlers/suspending_handler.c
    src/state_handlers/suspended_handler.c
    src/state_handlers/aborting_handler.c
    src/state_handlers/aborted_handler.c
    src/state_handlers/clearing_handler.c
)

# The code below locates the git index file for this repository and adds it as a dependency for
# the application VERSION file so that if the repo has a new commit added, even if no files in
# the build have changed, the application version file will be regenerated with the new git commit
find_package(Git QUIET)
if(GIT_FOUND)
  execute_process(
    COMMAND ${GIT_EXECUTABLE} rev-parse --absolute-git-dir
    WORKING_DIRECTORY .
    OUTPUT_VARIABLE application_git_dir
    OUTPUT_STRIP_TRAILING_WHITESPACE
    ERROR_STRIP_TRAILING_WHITESPACE
    ERROR_VARIABLE stderr
    RESULT_VARIABLE return_code
  )
  # If there is an error e.g. it is not a git repo, we just silently ignore it and continue
  # without a dependency, this will be the case with freestanding applications.
  if(NOT return_code)
    if(NOT "${stderr}" STREQUAL "")
      message(WARNING "Application build version git rev-parse warned: ${stderr}")
    endif()

    set_property(TARGET app_version_h PROPERTY APP_VERSION_DEPENDS ${application_git_dir}/index)
  endif()
endif()
```

## Kconfig
```
# Copyright (c) 2021 Nordic Semiconductor ASA
# SPDX-License-Identifier: Apache-2.0
#
# This file is the application Kconfig entry point. All application Kconfig
# options can be defined here or included via other application Kconfig files.
# You can browse these options using the west targets menuconfig (terminal) or
# guiconfig (GUI).

menu "Zephyr"
source "Kconfig.zephyr"
endmenu

config VCU_PORTS_MOCK
    bool "Use mock port implementations for testing and debug"
    default n
    help
        replace real driver-backed port read/write with static mock data. 
        enable in debug.conf

module = APP
module-str = APP
source "subsys/logging/Kconfig.template.log_config"
```

## prj.conf
```kconfig
CONFIG_NETWORKING=y
CONFIG_NET_SOCKETS=y
CONFIG_NET_IPV4=y
CONFIG_NET_UDP=y
CONFIG_LOG=y
CONFIG_CAN=y

CONFIG_NET_DHCPV4=y

# --- MCUmgr / DFU ---
CONFIG_MCUMGR=y
CONFIG_MCUMGR_GRP_IMG=y
CONFIG_MCUMGR_GRP_OS=y

# UDP transport
CONFIG_MCUMGR_TRANSPORT_UDP=y
CONFIG_MCUMGR_TRANSPORT_UDP_IPV4=y
CONFIG_MCUMGR_TRANSPORT_UDP_PORT=1337

# flash/image handling support
CONFIG_IMG_MANAGER=y
CONFIG_FLASH=y
CONFIG_FLASH_MAP=y
CONFIG_STREAM_FLASH=y

# needed by mcumgr's base64/CBOR encoding
CONFIG_BASE64=y
CONFIG_ZCBOR=y

CONFIG_GATEWAY_UDP_PORT=5555

CONFIG_UART_LINE_CTRL=y
CONFIG_SERIAL=y
CONFIG_STDOUT_CONSOLE=y

CONFIG_USB_DEVICE_STACK_NEXT=y
CONFIG_CDC_ACM_SERIAL_INITIALIZE_AT_BOOT=y
CONFIG_CDC_ACM_SERIAL_PID=0x1412
CONFIG_CDC_ACM_SERIAL_PRODUCT_STRING="Henry's CAN to UDP Converter"
```

## debug.conf
```kconfig
# Copyright (c) 2021 Nordic Semiconductor ASA
# SPDX-License-Identifier: Apache-2.0
#
# This is a Kconfig fragment which can be used to enable debug-related options
# in the application. See the README for more details.

# compiler
CONFIG_DEBUG_OPTIMIZATIONS=y

# logging
CONFIG_LOG=y
CONFIG_APP_LOG_LEVEL_DBG=y

CONFIG_MCUMGR_TRANSPORT_LOG_LEVEL_DBG=y
CONFIG_MCUMGR_GRP_IMG_LOG_LEVEL_DBG=y

CONFIG_VCU_PORTS_MOCK=y

CONFIG_SHELL=y

# telnet config
CONFIG_NET_TCP=y
CONFIG_NET_SHELL=y
CONFIG_SHELL_BACKEND_TELNET=y

CONFIG_STATIC_VCU_DEV=n
```

## src/main.c
```c
#include "udp_transport.h"
#include "fsm_thread.h"
#include "dhcp_req.h"
#include <zephyr/kernel.h>
#include <zephyr/drivers/gpio.h>

#include <zephyr/logging/log.h>
LOG_MODULE_REGISTER(main);

static void log_timer_handler(struct k_timer *timer) {
  LOG_DBG("Hello, World from Zephyr!");
}

K_TIMER_DEFINE(log_timer, log_timer_handler, NULL);

static const struct gpio_dt_spec led0 = GPIO_DT_SPEC_GET(DT_ALIAS(led0), gpios);
static const struct gpio_dt_spec led1 = GPIO_DT_SPEC_GET(DT_ALIAS(led1), gpios);
static const struct gpio_dt_spec led2 = GPIO_DT_SPEC_GET(DT_ALIAS(led2), gpios);

static void led_timer_handler(struct k_timer *timer) {
  gpio_pin_toggle_dt(&led0);
  gpio_pin_toggle_dt(&led1);
  gpio_pin_toggle_dt(&led2);
}

K_TIMER_DEFINE(led_timer, led_timer_handler, NULL);

struct UDPTransport udp_transport;

static void on_network_ready(struct net_if *iface) {
  udp_transport_init(&udp_transport);
  fsm_thread_start(&udp_transport);
}

int main(void) {

  gpio_pin_configure_dt(&led0, GPIO_OUTPUT_INACTIVE);
  gpio_pin_configure_dt(&led1, GPIO_OUTPUT_ACTIVE);
  gpio_pin_configure_dt(&led2, GPIO_OUTPUT_INACTIVE);
  k_timer_start(&led_timer, K_NO_WAIT, K_MSEC(200));

  dhcp_req_start(on_network_ready);

  k_timer_start(&log_timer, K_MSEC(1000), K_MSEC(1000));
  return 0;
}
```

## src/app_types.h
```c
#pragma once
#include <zephyr/kernel.h>

// FSM States and Transitions
enum FSMStates {
  FSM_BOOTING,
  FSM_STOPPED,
  FSM_IDLE,
  FSM_EXECUTE,
  FSM_HOLDING,
  FSM_HELD,
  FSM_STOPPING,
  FSM_SUSPENDING,
  FSM_SUSPENDED,
  FSM_ABORTING,
  FSM_ABORTED,
  FSM_CLEARING
};

enum FSMTransitions {
  TRAN_EVT_NONE,
  TRAN_EVT_ENABLE,
  TRAN_EVT_BOOTED,
  TRAN_EVT_RUN,
  TRAN_EVT_HOLD,
  TRAN_EVT_RESUME,
  TRAN_EVT_STOP,
  TRAN_EVT_SUSPEND,
  TRAN_EVT_UNSUSPEND,
  TRAN_EVT_ESTOP,
  TRAN_EVT_FAULT_CLEAR
};

// Input Ports
struct CommandHeader {
  uint8_t cmdType;
  uint32_t seqNum;
  int64_t timestampMs;
};

struct DriveVelocityCommand {
  struct CommandHeader hdr;
  float velocity;
  float headingRad;
};

struct DrivePositionCommand {
  struct CommandHeader hdr;
  float distance;
  float headingRad;
};

struct ArmCommand {
  struct CommandHeader hdr;
  uint16_t jointIdx;
  float armAngleRad;
};

struct SWSafetyCommands {
  enum FSMTransitions swCommand;
};

// Output Ports
struct IMUTelemetry {
  float ax, ay, az;
  float gx, gy, gz;
};

struct PowerTelemetry {
  float currentDraw;
  float batteryVoltage;
};

struct MotorStates {
  float wheelSpeedRPM;
  float wheelTorque;
  float encoderPositionRad;
  uint8_t isRunning;
};

struct ArmMotorStates {
  float encoderPositionRad;
  uint8_t isRunning;
};

struct PeripheralTelemetry {
  struct IMUTelemetry imu;
  struct PowerTelemetry power;
  struct MotorStates m1, m2, m3, m4;
  struct ArmMotorStates j1, j2, j3, j4, j5, j6;
};

// Safety State
struct SafetyState {
  bool estopAsserted;
  bool hwEnableActive;
  bool watchdogOk;
  bool upstreamHeartbeatOk;
  bool powerFault;
  bool motorFault;
  bool armFault;
  bool sensorFault;
};

// Internal Control Structs
struct VCUState {
  enum FSMStates cs, ns;
  struct SafetyState safety;

  // capabilities
  bool drive_allowed, arm_allowed, telemetry_active, config_mutable,
      manual_control_allowed, autonomy_control_allowed, fault_reset_allowed;
};

// Command Processing Telemetry
enum CommandStatus {
  CMD_ACCEPTED,
  CMD_REJECTED_FORMAT,
  CMD_REJECTED_STALE,
  CMD_REJECTED_SEQUENCE,
  CMD_REJECTED_WRONG_STATE,
  CMD_REJECTED_CAPABILITY,
  CMD_REJECTED_OUT_OF_RANGE,
  CMD_REJECTED_SAFETY,
  CMD_REJECTED_SUBSYSTEM
};

struct CommandTelemetry {
  enum CommandStatus lastStatus;
  uint32_t lastSeqNum;
  uint32_t acceptedCount;
  uint32_t rejectedCount;
};

// Diagnostic Counters
struct DiagnosticCounters {
  uint32_t uptimeMs;
  uint32_t resetCount;
  uint32_t rxPacketCount;
  uint32_t txPacketCount;
  uint32_t busErrorCount;
  uint32_t faultCount;
};

// Upstream Telemetry Output
struct VCUTelemetry {
  struct VCUState state;
  struct SafetyState safety;
  struct CommandTelemetry cmd;
  struct PeripheralTelemetry peripheral;
  struct DiagnosticCounters diag;
};
```

## src/dhcp_req.c
```c
#include "dhcp_req.h"

#include <zephyr/kernel.h>
#include <zephyr/net/net_if.h>
#include <zephyr/net/net_mgmt.h>
#include <zephyr/net/socket.h>

#include <zephyr/logging/log.h>
LOG_MODULE_REGISTER(dhcp_req);

#define DHCP_TIMEOUT_MS   10000
#define STATIC_IP_ADDR    "192.168.8.100"
#define STATIC_IP_NETMASK "255.255.255.0"

static struct net_mgmt_event_callback dhcp_cb;
static atomic_t dhcp_bound = ATOMIC_INIT(0);
static struct k_work_delayable dhcp_timeout_work;
static dhcp_req_ready_cb_t ready_cb;

static void dhcp_fallback_handler(struct k_work *work) {
  if (atomic_get(&dhcp_bound)) {
    return;
  }

  LOG_WRN("DHCP timeout, falling back to static IP: %s", STATIC_IP_ADDR);

  struct net_if *iface = net_if_get_default();
  net_dhcpv4_stop(iface);

  struct in_addr addr, netmask;
  net_addr_pton(AF_INET, STATIC_IP_ADDR, &addr);
  net_addr_pton(AF_INET, STATIC_IP_NETMASK, &netmask);

  net_if_ipv4_addr_add(iface, &addr, NET_ADDR_MANUAL, 0);
  net_if_ipv4_set_netmask_by_addr(iface, &addr, &netmask);

  if (ready_cb) {
    ready_cb(iface);
  }
}

static void dhcp_handler(struct net_mgmt_event_callback *cb,
                         uint64_t mgmt_event, struct net_if *iface) {
  if (mgmt_event == NET_EVENT_IPV4_DHCP_BOUND) {
    atomic_set(&dhcp_bound, 1);
    k_work_cancel_delayable(&dhcp_timeout_work);

    char buf[NET_IPV4_ADDR_LEN];
    net_addr_ntop(AF_INET, &iface->config.dhcpv4.requested_ip, buf,
                  sizeof(buf));

    LOG_INF("Received IP Lease: %s", buf);

    if (ready_cb) {
      ready_cb(iface);
    }
  }
}

void dhcp_req_start(dhcp_req_ready_cb_t on_ready) {
  ready_cb = on_ready;

  net_mgmt_init_event_callback(&dhcp_cb, dhcp_handler,
                               NET_EVENT_IPV4_DHCP_BOUND);
  net_mgmt_add_event_callback(&dhcp_cb);

  struct net_if *iface = net_if_get_default();
  net_dhcpv4_start(iface);

  k_work_init_delayable(&dhcp_timeout_work, dhcp_fallback_handler);
  k_work_schedule(&dhcp_timeout_work, K_MSEC(DHCP_TIMEOUT_MS));
}
```

## src/fsm.c
```c
#include "fsm.h"

int fsm_init(struct VCUState *state) {
  state->cs = FSM_BOOTING;
  state->ns = FSM_BOOTING;
  return 0;
}

int fsm_update_state(struct VCUState *state, enum FSMTransitions transition) {
  state->ns = state->cs;

  switch (state->cs) {
  case FSM_BOOTING:
    if (transition == TRAN_EVT_BOOTED)
      state->ns = FSM_STOPPED;
    break;

  case FSM_STOPPED:
    if (transition == TRAN_EVT_ENABLE)
      state->ns = FSM_IDLE;
    break;

  case FSM_IDLE:
    if (transition == TRAN_EVT_RUN)
      state->ns = FSM_EXECUTE;
    break;

  case FSM_EXECUTE:
    if (transition == TRAN_EVT_STOP)
      state->ns = FSM_STOPPING;
    else if (transition == TRAN_EVT_HOLD)
      state->ns = FSM_HOLDING;
    else if (transition == TRAN_EVT_SUSPEND)
      state->ns = FSM_SUSPENDING;
    break;

  case FSM_STOPPING:
    if (transition == TRAN_EVT_STOP)
      state->ns = FSM_STOPPED;
    break;

  case FSM_HOLDING:
    if (transition == TRAN_EVT_HOLD)
      state->ns = FSM_HELD;
    break;

  case FSM_HELD:
    if (transition == TRAN_EVT_RESUME)
      state->ns = FSM_EXECUTE;
    break;

  case FSM_SUSPENDING:
    if (transition == TRAN_EVT_SUSPEND)
      state->ns = FSM_SUSPENDED;
    break;

  case FSM_SUSPENDED:
    if (transition == TRAN_EVT_RESUME)
      state->ns = FSM_EXECUTE;
    break;

  default:
    state->ns = FSM_ABORTED;
    break;
  }

  return 0;
}

enum FSMTransitions fsm_do_state(struct VCUState *state,
                                 struct VCUPorts *ports) {
  switch (state->cs) {
  case FSM_BOOTING:
    return booting_handler(state, ports);
  case FSM_STOPPED:
    return stopped_handler(state, ports);
  case FSM_IDLE:
    return idle_handler(state, ports);
  case FSM_EXECUTE:
    return execute_handler(state, ports);
  case FSM_HOLDING:
    return holding_handler(state, ports);
  case FSM_HELD:
    return held_handler(state, ports);
  case FSM_STOPPING:
    return stopping_handler(state, ports);
  case FSM_SUSPENDING:
    return suspending_handler(state, ports);
  case FSM_SUSPENDED:
    return suspended_handler(state, ports);
  case FSM_ABORTING:
    return aborting_handler(state, ports);
  case FSM_ABORTED:
    return aborted_handler(state, ports);
  case FSM_CLEARING:
    return clearing_handler(state, ports);
  default:
    return TRAN_EVT_NONE;
  }
}

int fsm_commit_state(struct VCUState *state) {
  state->cs = state->ns;
  return 0;
}
```

## src/fsm.h
```c
#pragma once
#include "app_types.h"
#include "state_handlers/state_handlers.h"
#include <zephyr/kernel.h>

int fsm_init(struct VCUState *state);
int fsm_update_state(struct VCUState *state, enum FSMTransitions transition);
int fsm_commit_state(struct VCUState *state);

enum FSMTransitions fsm_do_state(struct VCUState *state, struct VCUPorts *ports);
```

## src/fsm_thread.c
```c
#include "fsm_thread.h"
#include "fsm.h"
#include "ports/ports.h"
#include <zephyr/kernel.h>
#include <zephyr/logging/log.h>

LOG_MODULE_REGISTER(fsm_thread);

#define FSM_THREAD_STACK_SIZE 2048
#define FSM_THREAD_PRIORITY   4 
#define FSM_TICK_MS           10 

K_THREAD_STACK_DEFINE(fsm_thread_stack, FSM_THREAD_STACK_SIZE);
static struct k_thread fsm_thread_data;

/* max 5 lets us detect overruns without silently dropping ticks */
K_SEM_DEFINE(fsm_tick_sem, 0, 5);

static struct VCUState vcu_state;
static struct VCUPorts vcu_ports;

static void fsm_tick_handler(struct k_timer *timer) {
  ARG_UNUSED(timer);
  k_sem_give(&fsm_tick_sem);
}

K_TIMER_DEFINE(fsm_tick_timer, fsm_tick_handler, NULL);

static void fsm_thread_fn(void *p1, void *p2, void *p3) {
  ARG_UNUSED(p1);
  ARG_UNUSED(p2);
  ARG_UNUSED(p3);

  fsm_init(&vcu_state);
  k_timer_start(&fsm_tick_timer, K_MSEC(FSM_TICK_MS), K_MSEC(FSM_TICK_MS));

  for (;;) {
    k_sem_take(&fsm_tick_sem, K_FOREVER);

    if (k_sem_count_get(&fsm_tick_sem) > 0) {
      LOG_WRN("FSM tick overrun (%u tick(s) pending)",
              k_sem_count_get(&fsm_tick_sem));
    }

    ports_read_inputs(&vcu_ports);

    enum FSMTransitions tran = fsm_do_state(&vcu_state, &vcu_ports);

    ports_write_outputs(&vcu_ports);

    if (tran != TRAN_EVT_NONE) {
      fsm_update_state(&vcu_state, tran);
    }

    fsm_commit_state(&vcu_state);
  }
}

int fsm_thread_start(struct UDPTransport *udp_transport) {
  ports_init(&vcu_ports, udp_transport);

  k_thread_create(&fsm_thread_data, fsm_thread_stack,
                  K_THREAD_STACK_SIZEOF(fsm_thread_stack), fsm_thread_fn,
                  NULL, NULL, NULL, FSM_THREAD_PRIORITY, 0, K_NO_WAIT);

  k_thread_name_set(&fsm_thread_data, "fsm_control");

  LOG_INF("FSM control thread started (%d ms tick)", FSM_TICK_MS);
  return 0;
}
```

## src/fsm_thread.h
```c
#pragma once
#include "udp_transport.h"

int fsm_thread_start(struct UDPTransport *udp_transport);
```

## src/udp_transport.c
```c
#include "udp_transport.h"
#include <zephyr/logging/log.h>

LOG_MODULE_REGISTER(udp_transport);

K_THREAD_STACK_DEFINE(udp_rx_stack, UDP_THREAD_STACK_SIZE);
static struct k_thread udp_rx_thread_data;

int udp_transport_init(struct UDPTransport *udp_transport) {

  LOG_INF("Initializing UDP Transport Layer");

  struct sockaddr_in bind_addr;
  int ret;

  udp_transport->udp_sock = zsock_socket(AF_INET, SOCK_DGRAM, IPPROTO_UDP);
  if (udp_transport->udp_sock < 0) {
    LOG_ERR("Failed to create UDP Socket: %d", errno);
    return -1;
  }

  memset(&bind_addr, 0, sizeof(bind_addr));
  bind_addr.sin_family = AF_INET;
  bind_addr.sin_port = htons(UDP_PORT);
  bind_addr.sin_addr.s_addr = htonl(INADDR_ANY);

  ret = zsock_bind(udp_transport->udp_sock, (struct sockaddr *)&bind_addr,
                   sizeof(bind_addr));
  if (ret < 0) {
    LOG_ERR("Failed to bind UDP Socket %d", errno);
    zsock_close(udp_transport->udp_sock);
    udp_transport->udp_sock = -1;
    return -errno;
  }

  LOG_INF("Socket seems to be ready...");

  k_msgq_init(&udp_transport->rx_msgq, (char *)udp_transport->rx_msgq_buffer,
              sizeof(struct UDPReceivedPacket), 100);

  k_msgq_init(&udp_transport->tx_msgq, (char *)udp_transport->tx_msgq_buffer,
              sizeof(struct UDPTransmittedPacket), 100);

  k_thread_create(&udp_rx_thread_data, udp_rx_stack,
                  K_THREAD_STACK_SIZEOF(udp_rx_stack), udp_rx_thread,
                  udp_transport, NULL, NULL, UDP_TRANSPORT_THREAD_PRIORITY, 0,
                  K_NO_WAIT);

  LOG_INF("Socket ready...");

  return 0;
}

struct UDPReceivedPacket
udp_transport_rx_parse(struct UDPTransport *udp_transport, uint8_t *buf,
                       ssize_t len) {
  struct UDPReceivedPacket pkt = {0};
  struct UDPReceivedPacket empty_pkt = {0};

  // confirm pkt is sized right...
  ssize_t min_pkt_len = sizeof(struct UDPPacketHeader);
  ssize_t max_pkt_len = min_pkt_len + sizeof(struct UDPReceivedPacket);

  if (len > max_pkt_len) {
    LOG_WRN("Received Packet too long (%zd bytes). Dropping...", len);
    return pkt;
  }

  if (len < min_pkt_len) {
    LOG_WRN("Received Packet too small (%zd bytes). Dropping...", len);
    return pkt;
  }

  // get pkt type;
  struct UDPPacketHeader header;
  memcpy(&header, buf, sizeof(header));

  // start parsing packet
  uint8_t *payload = buf + sizeof(header);
  pkt.type = (enum PacketType)header.type;
  ssize_t payload_len = len - sizeof(header);

  switch (pkt.type) {

  case PKT_RX_DRIVE_VEL_CMD:
    if (payload_len < (ssize_t)sizeof(pkt.drive_vel_cmd))
      goto too_short;
    memcpy(&pkt.drive_vel_cmd, payload, sizeof(pkt.drive_vel_cmd));
    break;

  case PKT_RX_DRIVE_POS_CMD:
    if (payload_len < (ssize_t)sizeof(pkt.drive_pos_cmd))
      goto too_short;
    memcpy(&pkt.drive_pos_cmd, payload, sizeof(pkt.drive_pos_cmd));
    break;

  case PKT_RX_ARM_CMD:
    if (payload_len < (ssize_t)sizeof(pkt.arm_cmd))
      goto too_short;
    memcpy(&pkt.arm_cmd, payload, sizeof(pkt.arm_cmd));
    break;

  case PKT_RX_SW_SAFETY_CMD:
    if (payload_len < (ssize_t)sizeof(pkt.sw_safety_cmd))
      goto too_short;
    memcpy(&pkt.sw_safety_cmd, payload, sizeof(pkt.sw_safety_cmd));
    break;

  default:
    LOG_WRN("Unknown Packet Type 0x%02x, Dropping...", pkt.type);
  }

  return pkt;

too_short:
  LOG_WRN("Payload too short for type 0x%02x (%zd bytes), dropping...",
          pkt.type, payload_len);
  return empty_pkt;
}

void udp_rx_thread(void *p1, void *p2, void *p3) {
  ARG_UNUSED(p2);
  ARG_UNUSED(p3);

  struct UDPTransport *udp_transport = (struct UDPTransport *)p1;
  // int sock = udp_transport->udp_sock;

  uint8_t rx_buf[UDP_PACKET_SIZE];

  LOG_INF("UDP RX Thread started, listenign on port %d", UDP_PORT);

  for (;;) {

    // wait for new msg
    struct sockaddr_in src_addr;
    socklen_t addr_len = sizeof(src_addr);

    ssize_t pkt_len =
        zsock_recvfrom(udp_transport->udp_sock, rx_buf, sizeof(rx_buf) - 1, 0,
                       (struct sockaddr *)&src_addr, &addr_len);

    if (pkt_len < 0) {
      LOG_ERR("recvfrom() failed %d", errno);
      k_msleep(100); // backoff for a bit;
      continue;
    }

    int null_loc = pkt_len > UDP_PACKET_SIZE
                       ? UDP_PACKET_SIZE
                       : pkt_len; // truncate if > UDP_PACKET_SIZE

    rx_buf[null_loc - 1] = '\0'; // null char termiate before printout!!! (heh)

    uint8_t rx_ip_buf[NET_IPV4_ADDR_LEN];
    net_addr_ntop(AF_INET, &src_addr.sin_addr, rx_ip_buf, NET_IPV4_ADDR_LEN);

    LOG_DBG("Received %zd bytes from %s", pkt_len, rx_ip_buf);
    LOG_DBG("TEXT: %s", rx_buf);

    // when new pkt rx process it; then enqueue if valid
    struct UDPReceivedPacket rxd_pkt =
        udp_transport_rx_parse(udp_transport, rx_buf, pkt_len);

    int ret = k_msgq_put(&udp_transport->rx_msgq, &rxd_pkt, K_NO_WAIT);
    if (ret < 0) {
      LOG_WRN("rx_msgq full, dropping packet %d", rxd_pkt.type);
    }
  }
}
```

## src/udp_transport.h
```c
#pragma once
#include "app_types.h"
#include <zephyr/kernel.h>
#include <zephyr/net/socket.h>

#define UDP_PORT 5555
#define UDP_PACKET_SIZE 1024
#define UDP_THREAD_STACK_SIZE 2048
#define UDP_TRANSPORT_THREAD_PRIORITY 5

struct UDPPacketHeader {
  uint8_t type;
  uint8_t version;
  uint16_t len;
};

enum PacketType {
  // transmit
  PKT_RX_DRIVE_VEL_CMD = 1,
  PKT_RX_DRIVE_POS_CMD = 2,
  PKT_RX_ARM_CMD = 3,
  PKT_RX_SW_SAFETY_CMD = 4,

  // receive
  PKT_TX_IMU_TELEMETRY = 11,
  PKT_TX_POWER_TELEMETRY = 12,
  PKT_TX_MOTOR_STATES = 13,
  PKT_TX_ARM_MOTOR_STATES = 14,
  PKT_TX_PERIPHERAL_TELEMETRY = 15,
  PKT_TX_SAFETY_STATE = 16,
};

struct UDPTransport {
  int udp_sock;
  // msgq for received packets to main control loop
  struct k_msgq rx_msgq;
  struct k_msgq tx_msgq;
  struct UDPReceivedPacket *rx_msgq_buffer[100];
  struct UDPTransmittedPacket *tx_msgq_buffer[100];
};

struct UDPReceivedPacket {
  enum PacketType type;
  union {
    struct DriveVelocityCommand drive_vel_cmd;
    struct DrivePositionCommand drive_pos_cmd;
    struct ArmCommand arm_cmd;
    struct SWSafetyCommands sw_safety_cmd;
  };
};

struct UDPTransmittedPacket {
  enum PacketType type;
  union {
    struct IMUTelemetry imu_telemetry;
    struct PowerTelemetry power_telemetry;
    struct MotorStates motor_states;
    struct ArmMotorStates arm_motor_states;
    struct PeripheralTelemetry peripheral_telemetry;
    struct SafetyState safety_state;
  };
};

int udp_transport_init(struct UDPTransport *udp_transport);
struct UDPReceivedPacket udp_transport_rx_parse(struct UDPTransport *udp_transport,
                                                uint8_t *buf, ssize_t len);
void udp_rx_thread(void *p1, void *p2, void *p3);
struct UDPReceivedPacket
udp_transport_rx_parse(struct UDPTransport *udp_transport, uint8_t *buf,
                       ssize_t len);
```
